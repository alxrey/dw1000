## boards/in-circuit/radino40_usbstick/Kconfig.radino40_usbstick
```kconfig
# SPDX-License-Identifier: Apache-2.0

config BOARD_RADINO40_USBSTICK
	select SOC_NRF52840_QIAA
```

## boards/in-circuit/radino40_usbstick/board.yml
```yaml
board:
  name: radino40_usbstick
  full_name: radino40 DW1000 USB-Stick
  vendor: In-Circuit GmbH
  socs:
  - name: nrf52840
```

## boards/in-circuit/radino40_usbstick/radino40_usbstick_defconfig
```kconfig
#
# SPDX-License-Identifier: Apache-2.0
#

# Enable MPU
CONFIG_ARM_MPU=y

# Enable GPIO
CONFIG_GPIO=y

# Enable SPI
CONFIG_SPI=y

# Enavle console
CONFIG_CONSOLE=y
CONFIG_UART_CONSOLE=y
CONFIG_UART_LINE_CTRL=y

# Enable UART
CONFIG_SERIAL=y
```

## drivers/dw1000/Kconfig
```kconfig
config DW1000
	bool "DW1000 device driver"
	default y
	depends on DT_HAS_QORVO_DW1000_ENABLED
	select SPI
	select GPIO
	help
	  Enable DW1000 driver.
```

## dts/bindings/qorvo,dw1000.yaml
```yaml
# Copyright (c) 2025 Swiss Timing Ltd.

description: Qorvo DW1000 802.15.4 UWB transceiver

compatible: "qorvo,dw1000"

include: spi-device.yaml

properties:
  int-gpios:
    type: phandle-array
    required: true
    description: Interrupt pin IRQ, active high.

  reset-gpios:
    type: phandle-array
    required: true
    description: RESET pin, active low.

  wakeup-gpios:
    type: phandle-array
    description: WAKEUP pin, active high.

  rxokled-gpios:
    type: phandle-array
    description: RX OK LED pin, active high.

  sfdled-gpios:
    type: phandle-array
    description: SFD LED pin, active high.

  rxled-gpios:
    type: phandle-array
    description: RX LED pin, active high.

  txled-gpios:
    type: phandle-array
    description: TX LED pin, active high.
```
